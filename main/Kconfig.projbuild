## main/Kconfig.projbuild
```kconfig
menu "App"
    menu "Module config"         
        config MODULE_OPTION
            int "Module optional time (ms)"
            range 1000 8000
            default 3000
            help
                Time press detection threshold in ms.
    endmenu
endmenu
```
